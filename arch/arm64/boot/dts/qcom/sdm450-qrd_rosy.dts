/*
 * Copyright (c) 2017, The Linux Foundation. All rights reserved.
 * Copyright (C) 2019 XiaoMi, Inc.
 *
 * This program is free software; you can redistribute it and/or modify
 * it under the terms of the GNU General Public License version 2 and
 * only version 2 as published by the Free Software Foundation.
 *
 * This program is distributed in the hope that it will be useful,
 * but WITHOUT ANY WARRANTY; without even the implied warranty of
 * MERCHANTABILITY or FITNESS FOR A PARTICULAR PURPOSE.  See the
 * GNU General Public License for more details.
 */

/dts-v1/;

#include "sdm450.dtsi"
#include "pmi8940.dtsi"
#include "msm8953-mdss-panels.dtsi"

/ {
	model = "Qualcomm Technologies, Inc. SDM450 + PMI8940 QRD";
	compatible = "qcom,sdm450-qrd", "qcom,sdm450", "qcom,qrd";
	qcom,board-id = <0x1000b 1>;
	qcom,msm-id = <338 0x0>;
};

#include "rosy/rosy-display.dtsi"
#include "rosy/rosy-qrd.dtsi"
#include "rosy/rosy-pinctrl.dtsi"
#include "rosy/rosy-camera.dtsi"
#include "rosy/rosy-general.dtsi"
#include "rosy/rosy-pm.dtsi"
#include "rosy/rosy-regulator.dtsi"
#include "rosy/rosy-audio.dtsi" 
