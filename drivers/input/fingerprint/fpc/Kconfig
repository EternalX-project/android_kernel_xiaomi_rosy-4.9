## drivers/input/fingerprint/fpc/Kconfig
```kconfig
config FINGERPRINT_FPC1020
	tristate "FPC1020 fingerprint driver"
	depends on INPUT_FINGERPRINT
	help
	  Say Y here to enable goodix fingerprint driver support!
```

## drivers/input/fingerprint/goodix/Kconfig
```kconfig
config FINGERPRINT_GOODIX_GF3208
	tristate "GF3208 fingerprint driver"
	depends on INPUT_FINGERPRINT
	help
	  add support for goodix fingerprint driver.
```

## drivers/input/touchscreen/FT8006m/Kconfig
```kconfig
#
# Focaltech Touchscreen driver configuration
#

config TOUCHSCREEN_FT8006M
        bool "FT8006M touchscreen driver"
		depends on I2C
		default n
		help
		  Say Y here to compile touchscreen drivers for FocalTech FT8006M.
		  If unsure, say N.
```

## drivers/input/touchscreen/FT8716/Kconfig
```kconfig
#
# Focaltech Touchscreen driver configuration
#

config TOUCHSCREEN_FT8716
        bool "FT8716 touchscreen driver"
		depends on I2C
		default n
		help
		  Say Y here to compile touchscreen drivers for FocalTech FT8716.
		  If unsure, say N.
```

## drivers/rosy/Kconfig
```kconfig
#
# ROSY drivers
#
menu "Xiaomi Redmi 5 (ROSY) Drivers"

config MACH_XIAOMI_ROSY
	bool "Xiaomi Redmi 5 (ROSY) platform"
	select CONFIG_ARCH_MSM8953
	select CONFIG_ARCH_SDM450
	help
	  Support for rosy platform & DT overlay

source "drivers/rosy/soc/Kconfig"

endmenu
```

## drivers/rosy/soc/Kconfig
```kconfig
menuconfig SOC_ROSY
	bool "SoC drivers"
	help
	  Say Y here, and a list of supported SoC drivers will be
	  displayed. This option doesn't affect the kernel.

	  If unsure, say Y.

if SOC_ROSY

config SERIAL_NUM_ROSY
	bool "Serial number proc interface"
	depends on SOC_ROSY
	help
	  Say Y here to enable proc interface used for reading of CPU
	  serial number.

	  If unsure, say Y.

config SECBOOT_FUSE_ROSY
	bool "Secure boot fuse proc interface"
	depends on SOC_ROSY
	help
	  Say Y here to enable proc interface used for reading of CPU
	  secure boot fuse setting. The interface is located in
	  /proc/secboot_fuse_reg

	  If unsure, say Y.

config CPUMAXFREQ_ROSY
	bool "CPUMAXFREQ proc interface"
	depends on SOC_ROSY
	help
	  Say Y here to enable proc interface used for getting the maximum
	  frequency supported by the CPU.

	  If unsure, say Y.

config BOOT_INFO_ROSY
	bool "Bootloader information interface"
	depends on SOC_ROSY
	help
	  Say Y here to enable interface used to collect information from
	  the bootloader of ROSY and pass it to the kernel.

	  If unsure, say Y.

config HARDWARE_INFO_ROSY
	bool "Hardware information interface"
	depends on SOC_ROSY
	help
	  Say Y here to enable interface used to collect information
	  about the hardware of ROSY.

	  If unsure, say Y.

endif
```
